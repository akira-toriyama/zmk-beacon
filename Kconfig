## Kconfig
```kconfig
# Copyright (c) 2026 akira-toriyama
# SPDX-License-Identifier: MIT
#
# Module-wide options, all BEACON_*.

menu "Beacon"

config BEACON_SCREEN
    bool "Show the keyboard's status advertisement on this device's display"
    depends on ZMK_DISPLAY_STATUS_SCREEN_CUSTOM && BT
    select BT_OBSERVER
    help
      ZMK's custom status screen (src/prospector_screen.c): the keyboard's
      battery as an HP bar along the bottom, under the sprite with
      BEACON_SPRITE, from the status advertisement (BEACON_STATUS_BROADCAST)
      that the observer (src/status_observer.c) scans for passively. The
      observer brings Bluetooth up itself, for a display device whose
      ZMK_BLE is off, never a keyboard. The screen's options follow it: the
      backlight (BEACON_BACKLIGHT_BRIGHTNESS) and the screen-off time
      (BEACON_SCREEN_OFF_AFTER_S) with a pwm-leds node, whose LED 0 is the
      backlight; the sprite (BEACON_SPRITE_GIF); the sprite room
      (BEACON_SPRITE_RECEIVE) with a sprite_partition in the devicetree. It
      also needs LVGL's label and bar widgets (CONFIG_LV_USE_LABEL,
      CONFIG_LV_USE_BAR) and unscii 16 as LVGL's default font. The
      prospector shield turns it on and sets all of that; no other display
      has run it.

config BEACON_BACKLIGHT_BRIGHTNESS
    int "Backlight brightness of the lit screen (percent)"
    range 0 100
    default 80
    depends on BEACON_SCREEN && LED_PWM
    help
      Duty cycle written to the backlight, LED 0 of the devicetree's
      pwm-leds node, at boot, before LVGL and ZMK's display start. No
      ambient light sensor is read (the prospector shield's beekeeb unit has
      none), so a lit screen keeps this value; BEACON_SCREEN_OFF_AFTER_S
      turns the backlight off and back on to it.

config BEACON_SCREEN_OFF_AFTER_S
    int "Turn the screen off after this many seconds without a key press (0 = never)"
    range 0 86400
    default 300
    depends on BEACON_SCREEN && LED_PWM
    help
      Once the keyboard's status payload has counted no key press for this
      long, the backlight fades out within a second and the panel is
      blanked; the next key press lights the screen again (src/screen_off.c).
      ZMK's own CONFIG_ZMK_DISPLAY_BLANK_ON_IDLE must stay off
      (src/prospector_screen.c).
      Only the keyboard's key presses count, any key, either half's on a
      split: the device hears nothing else, so a pointing device does not
      keep the screen lit. Until the first key press the time since boot
      counts, so the screen also goes dark when no keyboard is heard. 0: the
      screen stays lit.

config BEACON_SCREEN_OFF
    bool
    default y if BEACON_SCREEN_OFF_AFTER_S > 0
    help
      Set when BEACON_SCREEN_OFF_AFTER_S is above 0.

config BEACON_BOOTLOADER_ON_1200_BAUD
    bool "Enter the UF2 bootloader on a 1200 baud touch"
    depends on USB_CDC_ACM
    select RETENTION_BOOT_MODE
    select CDC_ACM_DTE_RATE_CALLBACK_SUPPORT
    help
      When the host sets any CDC ACM port of the device to 1200 baud (for
      example "stty -f /dev/cu.usbmodemXXXX 1200" on macOS), set the retained
      boot mode to bootloader and warm-reboot 250 ms later, so the UF2
      bootloader mounts its drive without a reset double-tap. The delay lets
      the host's control transfer complete before the device resets.

      Any program that sets the port to 1200 baud, a serial monitor included,
      reboots the device. The prospector shield turns this on by default
      because the unit has no key for &bootloader and no touch input.

      The boot mode needs the board's retention support (RETENTION, a
      zephyr,boot-mode retention area; ZMK's xiao_ble board has both). It is
      selected rather than depended on, so a board without it fails the
      Kconfig step instead of silently building without the entry.

config BEACON_SCREEN_DUMP
    bool "Send the screen to the host on a 2400 baud touch"
    depends on BEACON_BOOTLOADER_ON_1200_BAUD && ZMK_DISPLAY && LV_COLOR_DEPTH_16
    select UART_INTERRUPT_DRIVEN
    select CRC
    help
      When the host sets the CDC ACM port to 2400 baud, render the whole
      screen once more and send it over that port as RGB565 bands closed by
      a CRC-32 (the format: src/screen_dump.c), for a host to turn into a
      picture (canon's "scripts/dongle.py shot", for example, writes a PNG).
      The screen stands still while the bands go out, and a logging image
      drops the log lines of that time: the dump has the port to itself.

      It uses the 1200 baud entry's rate callback (the CDC ACM class driver
      keeps one per device), hence the dependency. The prospector shield
      turns this on by default.

config BEACON_SPRITE_GIF
    string "GIF sprite embedded in the image (absolute path, empty = none)"
    default ""
    depends on BEACON_SCREEN
    help
      Absolute path of a GIF (any that a browser plays, up to 255 colours in
      all). The build converts it into a sprite pack (tools/sprite_pack.py,
      docs/sprite-pack.md), embeds that in the image, and the status screen
      plays it above the HP bar, scaled to fill the space between the panel's
      top edge and the bar: at SPEED_PCT of its own tempo (src/sprite.c)
      while nobody types, and stepped by the key presses the keyboard's
      broadcaster counts while it is typed on (src/sprite.c). Empty: no
      embedded sprite, which is what CI and the release build; with
      BEACON_SPRITE_RECEIVE the screen then shows the pack received last, or
      no sprite until one arrives.

      The build fails when the GIF does not fit that space at 1x
      (src/prospector_screen.c), or when the player's share of the LVGL
      pool, kept for the whole run (two bytes a pixel at 8 bits a pixel, one
      at 4), does not fit CONFIG_LV_Z_MEM_POOL_SIZE next to the screen
      (CMakeLists.txt; the prospector shield's default grows with a sprite).
      Local builds: scripts/build.sh --sprite <gif> [--sprite-name <text>].

config BEACON_SPRITE_EMBEDDED
    bool
    default y if BEACON_SPRITE_GIF != ""
    help
      Set when BEACON_SPRITE_GIF names a file: the image carries a sprite
      pack, which the screen shows when the sprite room holds none
      (BEACON_SPRITE_RECEIVE) and falls back to after a failed transfer.

config BEACON_SPRITE_RECEIVE
    bool "Receive a sprite pack over BLE into flash and play it"
    depends on BEACON_SCREEN && $(dt_nodelabel_enabled,sprite_partition)
    select BT_PERIPHERAL
    select FLASH
    select FLASH_MAP
    select SOC_FLASH_NRF_PARTIAL_ERASE if HAS_HW_NRF_NVMC_PE
    help
      The device advertises connectably under BT_DEVICE_NAME and offers one
      GATT service through which a central writes a sprite pack
      (tools/sprite_pack.py) into the sprite room, the devicetree's flash
      partition labelled sprite_partition (the prospector shield's overlay
      cuts 384 KiB of it from the code partition); the screen then plays
      that pack, named as the pack says, without a reboot, and at the next
      boot plays it again when it is whole (src/ble_receiver.c, its header
      is the protocol). No pairing and no encryption: anyone in range
      can connect, write the room and read the report, which gives the name
      of the sprite playing, where it came from, and the last transfer since
      boot with the pack's size; nothing else. On by default for the
      prospector shield; a consumer's prospector.conf turns it off with =n.

      Costs on the nRF52840 against the observer-only build (2026-10-12):
      about 80 KB of flash and 40 KB of RAM, 16 KB of it the LVGL pool a
      sprite build grows (Kconfig.defconfig), the rest BT_PERIPHERAL, the
      251 byte ACL buffers and the BT RX stack the shield's Kconfig.defconfig
      sets, and one flash page as the write buffer. The observer's scan stops
      while a central is connected (seconds a day). The flash erase needs
      SOC_FLASH_NRF_PARTIAL_ERASE (selected; a page erase without it halts
      the CPU, and a long erase drops the connection); a SoC without partial
      erase fails src/ble_receiver.c's BUILD_ASSERT.

config BEACON_SPRITE
    bool
    default y if BEACON_SPRITE_EMBEDDED || BEACON_SPRITE_RECEIVE
    select SYS_HEAP_RUNTIME_STATS if LOG
    help
      Set when the image plays a sprite: embedded, received, or both. The
      sprite decodes and draws itself (src/sprite.c, src/sprite_pack.c); no
      LVGL image or GIF library is built. With logging on, the sprite's
      minute line reports the LVGL pool's allocated and peak bytes, the
      numbers the pool size is chosen from.

config BEACON_SPRITE_NAME
    string "Name of the sprite, shown above the HP bar (empty = none)"
    default ""
    help
      Written into the embedded sprite pack (BEACON_SPRITE_GIF), from which
      the HP bar shows it on the first row of its box, above the bar: the
      box grows by that row and the sprite's space above it shrinks
      (src/hp_bar.h). 15 bytes of UTF-8 at most, all printable ASCII (shown
      in unscii 16) or all katakana (the pkmn font, src/font_pkmn.c: U+30A1
      to U+30FC, the gender signs, the fullwidth digits, colon and
      capitals), as tools/sprite_pack.py checks when it converts the GIF:
      any other name stops the build. Without a double quote or a backslash, which would
      need Kconfig escaping, and without "??", a C trigraph in autoconf.h.
      Empty: no name for the embedded sprite. A received pack brings its own
      name (BEACON_SPRITE_RECEIVE), and that build always has the row, so
      the screen of CI and the release build has an empty one until a pack
      plays.

      No dependency on purpose: kconfig.py prints the value of any assigned
      symbol whose value did not take, so a dependency on BEACON_SPRITE
      would print the name in every build where the sprite ends up off (a
      display-off --kconfig, another shield).

      Like the GIF, the name is a personal file's and never goes into a
      repository: a local build passes it (scripts/build.sh --sprite <gif>
      --sprite-name <text>, through a Kconfig fragment so that a failed
      configure step, whose command line west prints, shows only the
      fragment's path; a consumer derives it as it likes: canon's
      assets/sprite-name.py, for example, takes it from its name dictionary
      or the GIF's file name).

config BEACON_HP_BAR_NAME_ROW
    bool
    default y if BEACON_SPRITE && (BEACON_SPRITE_NAME != "" || BEACON_SPRITE_RECEIVE)
    help
      Set when the HP bar's box has the name row: an embedded sprite with a
      name, or the receiver, whose packs name themselves (src/hp_bar.h).

config BEACON_STATUS_BROADCAST
    bool "Broadcast the keyboard's status on a second advertising set"
    depends on (!ZMK_SPLIT || ZMK_SPLIT_ROLE_CENTRAL) && BT && SETTINGS
    select BT_EXT_ADV
    help
      On the device that runs the keyboard's keymap (a keyboard that is not
      a split, or a split's central: a dongle, or the half that is the
      central), advertise the status payload (the batteries,
      BEACON_OWN_BATTERY, the highest active layer and its name, a count of
      key presses and the modifiers held; src/status_payload.h) as
      manufacturer data in a legacy, non-connectable, non-scannable
      advertising set next to ZMK's own connectable one, refreshed every
      BEACON_PAYLOAD_INTERVAL_MS (src/status_payload.h) and right after a
      key press. The Prospector Dongle's observer (BEACON_SCREEN) reads it,
      and so can anyone in range: the payload is plaintext, and it tells how
      much is typed in each interval and which modifiers are held, never
      which keys (README, "The status advertisement").

      The consumer's config must also set CONFIG_BT_EXT_ADV_MAX_ADV_SET=2:
      with BT_EXT_ADV the host takes ZMK's legacy advertising from the same
      pool of sets, and the build fails on a pool of 1. BT_EXT_ADV costs
      about 34 KB of flash and 11 KB of RAM on nRF52840 and switches the host
      to the extended HCI commands. With it a split central's scan for its
      halves is an extended scan, and ZMK's Zephyr fork lacks upstream
      5ce9d0c621, so a nearby AuxPtr with an invalid channel index can trip a
      controller assert while a half is away (read from the code, never
      seen).

      The batteries need ZMK's CONFIG_ZMK_BATTERY_REPORTING, on by default
      with Bluetooth: without it the broadcaster builds and every battery
      byte stays 0. A split central's peripherals need
      CONFIG_ZMK_SPLIT_BLE_CENTRAL_BATTERY_LEVEL_FETCHING=y as well: the
      broadcaster reads ZMK's peripheral battery events, which a central
      raises only with it (off by ZMK's default); without it their bytes
      stay 0, and a dongle's Prospector Dongle shows --/100. Neither
      selected nor asserted: the key presses and the modifiers work without
      it, and on stock ZMK the option carries an unchecked write at the
      disconnect of a Bluetooth host (zmk#3522, its fix zmk#3556 open), which
      a central that takes such hosts may choose to avoid.

choice BEACON_OWN_BATTERY
    prompt "The battery byte that carries this device's own battery"
    depends on BEACON_STATUS_BROADCAST
    default BEACON_OWN_BATTERY_NONE if ZMK_SPLIT_ROLE_CENTRAL && ZMK_SPLIT_BLE_CENTRAL_PERIPHERALS > 1
    default BEACON_OWN_BATTERY_LEFT
    help
      The payload has two battery bytes, the left half's and the right
      half's, 0 for no reading (src/status_payload.h). The battery of the
      device that runs the broadcaster, ZMK's battery level, goes into the
      byte named here, and a split central's peripherals fill the others in
      ZMK's slot order, slot 0 first: a slot is the order the central first
      heard each peripheral in, kept in its settings. The defaults: a
      keyboard that is not a split, and a split central with one
      peripheral, a central half, send their own in the left byte (a
      keyboard whose central is its right half picks RIGHT, and its left
      half then fills the left byte); a split central with more
      peripherals, a dongle, sends none, its first two peripherals filling
      both bytes. A dongle with one peripheral picks NONE too.

config BEACON_OWN_BATTERY_LEFT
    bool "The left byte"

config BEACON_OWN_BATTERY_RIGHT
    bool "The right byte"

config BEACON_OWN_BATTERY_NONE
    bool "Neither: the peripherals fill both (a dongle)"

endchoice

endmenu
```

## boards/shields/prospector/Kconfig.shield
```kconfig
# Copyright (c) 2026 akira-toriyama
# SPDX-License-Identifier: MIT

config SHIELD_PROSPECTOR
    def_bool $(shields_list_contains,prospector)
```
